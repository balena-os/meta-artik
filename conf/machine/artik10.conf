## conf/machine/artik10.conf
```bitbake
#@TYPE: Machine
#@NAME: Samsung Artik 10
#@SOC:Exynos 5422
#@DESCRIPTION: Machine configuration for Samsung Artik 10
#@MAINTAINER:

DEFAULTTUNE ?= "cortexa15thf-neon"
require conf/machine/include/artik520-artik10.inc
require conf/machine/include/tune-cortexa15.inc

PREFERRED_PROVIDER_u-boot ?= "u-boot-artik520-artik10"
PREFERRED_PROVIDER_virtual/kernel ?= "linux-yocto-artik520-artik10"

KERNEL_DEVICETREE ?= "exynos5422-artik10.dtb"

UBOOT_MACHINE ?= "artik10"

KBUILD_DEFCONFIG = "artik10_defconfig"

UBOOT_PARAMS_OFFSET ?= "1231"

SERIAL_CONSOLE = "115200 ttySAC3"

MACHINE_FEATURES += " usbhost"
```

## conf/machine/artik5.conf
```bitbake
#@TYPE: Machine
#@NAME: Samsung Artik 5
#@SOC: Exynos 3250
#@DESCRIPTION: Machine configuration for Samsung Artik 5
#@MAINTAINER:

DEFAULTTUNE ?= "cortexa7thf-neon-vfpv4"
require conf/machine/include/artik.inc
require conf/machine/include/tune-cortexa7.inc

KERNEL_DEVICETREE ?= "exynos3250-artik5.dtb"

UBOOT_PARAMS_OFFSET ?= "1031"

SERIAL_CONSOLE = "115200 ttySAC2"
```

## conf/machine/artik520.conf
```bitbake
#@TYPE: Machine
#@NAME: Samsung Artik 520
#@SOC: Exynos 3250
#@DESCRIPTION: Machine configuration for Samsung Artik 520
#@MAINTAINER:

require conf/machine/include/artik.inc
require conf/machine/include/tune-cortexa7.inc

DEFAULTTUNE ?= "cortexa7thf-neon-vfpv4"

PREFERRED_PROVIDER_u-boot ?= "u-boot-artik520-artik10"
PREFERRED_PROVIDER_virtual/kernel ?= "linux-yocto-artik520-artik10"

UBOOT_MACHINE = "artik5"

KBUILD_DEFCONFIG = "artik5_defconfig"

SERIAL_CONSOLE = "115200 ttySAC2"

KERNEL_DEVICETREE = "exynos3250-artik5.dtb"

UBOOT_PARAMS_OFFSET = "1031"
```

## conf/machine/artik530.conf
```bitbake
#@TYPE: Machine
#@NAME: Samsung Artik 530
#@SOC: Samsung S5P4418
#@DESCRIPTION: Machine configuration for Samsung Artik 530
#@MAINTAINER:

MACHINEOVERRIDES = "artik53x:${MACHINE}"
include conf/machine/artik53x.conf

KERNEL_DEVICETREE = "s5p4418-artik530-explorer.dtb s5p4418-artik530-raptor-rev00.dtb s5p4418-artik530-raptor-rev03.dtb"

UBOOT_MACHINE = "artik530_raptor_defconfig"

KBUILD_DEFCONFIG = "artik530_raptor_defconfig"
```

## conf/machine/artik533s.conf
```bitbake
#@TYPE: Machine
#@NAME: Samsung Artik 533s
#@SOC: Samsung S5P4418
#@DESCRIPTION: Machine configuration for Samsung Artik 533s
#@MAINTAINER:

MACHINEOVERRIDES = "artik53x:${MACHINE}"
include conf/machine/artik53x.conf

KERNEL_DEVICETREE = "s5p4418-artik533-compy.dtb s5p4418-artik533-raptor-rev00.dtb"

UBOOT_MACHINE = "artik533_raptor_defconfig"

KBUILD_DEFCONFIG = "artik530_raptor_defconfig"

SECUREOS = "secureos.img"
SECUREOS_OFFSET = "769"
```

## conf/machine/artik53x.conf
```bitbake
# Machine with common settings for Samsung Artik 53x boards (530, 530s, 533, 533s)

require conf/machine/include/artik.inc
require conf/machine/include/tune-cortexa9.inc

DEFAULTTUNE = "cortexa9thf-neon"

PREFERRED_PROVIDER_u-boot = "u-boot-artik53x"
PREFERRED_PROVIDER_virtual/kernel = "linux-yocto-artik53x"

BL1_EMMC = "bl1-emmcboot.img"
BL1_SD = "bl1-sdboot.img"
BL_MON = "bl_mon.img"
LOADER_EMMC = "loader-emmc.img"
LOADER_SD = "loader-sd.img"

# Offsets for generating the final image
BL1_OFFSET = "1"
LOADER_OFFSET = "129"
BL_MON_OFFSET = "513"
UBOOT_OFFSET = "3841"
ENV_OFFSET = "5889"

SERIAL_CONSOLE = "115200 ttyAMA3"

MACHINE_ESSENTIAL_EXTRA_RRECOMMENDS += "linux-firmware-artik53x sd8x-rfkill"
```

## conf/machine/include/artik.inc
```bitbake
# Common settings for Samsung Artik boards
IMAGE_CLASSES += "artik-sdimg"

MACHINE_FEATURES += " bluetooth pci rtc ethernet serial usbgadget wifi"

KERNEL_IMAGETYPE = "zImage"
IMAGE_FSTYPES += "tar.bz2 ext4 artik-sdimg"

MACHINE_ESSENTIAL_EXTRA_RRECOMMENDS += "boot-firmware-artik kernel-modules rfkill-unblock"
```

## conf/machine/include/artik520-artik10.inc
```bitbake
require conf/machine/include/artik.inc

MACHINE_ESSENTIAL_EXTRA_RRECOMMENDS += "bcm4354-bt bcm4354-nvram-config"

KERNEL_MODULE_AUTOLOAD += "dhd"
KERNEL_MODULE_PROBECONF += "dhd"
module_conf_dhd = "options dhd firmware_path=/lib/firmware/brcm/brcmfmac4354-sdio.bin nvram_path=/lib/firmware/brcm/brcmfmac4354-sdio.txt"
```

## conf/machine/kitra520.conf
```bitbake
#@TYPE: Machine
#@NAME: RushUp Kitra 520
#@SOC: Exynos 3250
#@DESCRIPTION: Machine configuration for RushUp Kitra 520

MACHINEOVERRIDES = "artik520:${MACHINE}"
include conf/machine/artik520.conf
```
